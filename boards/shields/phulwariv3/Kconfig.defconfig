## boards/shields/phulwariv3/Kconfig.defconfig
```kconfig
if SHIELD_PHULWARIV3_RIGHT

# Name must be less than 16 characters long!
config ZMK_KEYBOARD_NAME
    default "PhulwariV3"

config ZMK_SPLIT_ROLE_CENTRAL
    default y

endif

if SHIELD_PHULWARIV3_LEFT || SHIELD_PHULWARIV3_RIGHT

config ZMK_SPLIT
    default y

config ZMK_BLE_EXPERIMENTAL_FEATURES
    default y

endif

# ---------------------
# Kconfig for shield "phulwariv3_left" with board "nice_nano_v2"
# ---------------------
if BOARD_NICE_NANO_V2 && SHIELD_PHULWARIV3_LEFT


endif

# ---------------------
# Kconfig for shield "phulwariv3_right" with board "nice_nano_v2"
# ---------------------
if BOARD_NICE_NANO_V2 && SHIELD_PHULWARIV3_RIGHT


endif
```
